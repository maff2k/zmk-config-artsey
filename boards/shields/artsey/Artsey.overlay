/*
 * Copyright (c) 2021 Mike "KemoNine" Crosson
 *
 * SPDX-License-Identifier: MIT
 */

#include <dt-bindings/zmk/matrix_transform.h>

/ {
	chosen {
		zmk,kscan = &kscan0;
	};

	kscan0: kscan {
		compatible = "zmk,kscan-gpio-direct";

		label = "kscan0";

		input-gpios
			= <&xiao_d 0 (GPIO_ACTIVE_LOW | GPIO_PULL_UP)>
            , <&xiao_d 1 (GPIO_ACTIVE_LOW | GPIO_PULL_UP)>
            , <&xiao_d 2 (GPIO_ACTIVE_LOW | GPIO_PULL_UP)>
            , <&xiao_d 3 (GPIO_ACTIVE_LOW | GPIO_PULL_UP)>
            , <&xiao_d 10 (GPIO_ACTIVE_LOW | GPIO_PULL_UP)>
            , <&xiao_d 16 (GPIO_ACTIVE_LOW | GPIO_PULL_UP)>
            , <&xiao_d 14 (GPIO_ACTIVE_LOW | GPIO_PULL_UP)>
            , <&xiao_d 15 (GPIO_ACTIVE_LOW | GPIO_PULL_UP)>
            ;
	};
};
