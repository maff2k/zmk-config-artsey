/*
 * Copyright (c) 2021 Mike "KemoNine" Crosson
 *
 * SPDX-License-Identifier: MIT
 */

/* #include <dt-bindings/zmk/matrix_transform.h> */

/ {
	chosen {
		zmk,kscan = &kscan0;
	};


kscan0: kscan_0 {
		#gpio-cells = <2>;
		compatible = "zmk,kscan-gpio-matrix";
		// compatible = "seeed,xiao-gpio";

		label = "KSCAN";

		gpio-map
            		= <0 0 &gpio0 0 0>      /* D0 */
            		, <1 0 &gpio0 1 0>      /* D1 */
            		, <2 0 &gpio0 2 0>      /* D2 */
            		, <3 0 &gpio0 3 0>      /* D3 */
            		, <4 0 &gpio0 4 0>      /* D4 */
           		, <5 0 &gpio0 5 0>      /* D5 */
            		, <6 0 &gpio0 6 0>      /* D6 */
            		, <7 0 &gpio0 7 0>      /* D7 */
           	;

		/* input-gpios
			= <&xiao_d 0  (GPIO_ACTIVE_LOW | GPIO_PULL_UP)>
			, <&xiao_d 1  (GPIO_ACTIVE_LOW | GPIO_PULL_UP)>
			, <&xiao_d 2  (GPIO_ACTIVE_LOW | GPIO_PULL_UP)>
			, <&xiao_d 3  (GPIO_ACTIVE_LOW | GPIO_PULL_UP)>  
			, <&xiao_d 4  (GPIO_ACTIVE_LOW | GPIO_PULL_UP)>
			, <&xiao_d 5  (GPIO_ACTIVE_LOW | GPIO_PULL_UP)>
			, <&xiao_d 6  (GPIO_ACTIVE_LOW | GPIO_PULL_UP)>
			, <&xiao_d 7  (GPIO_ACTIVE_LOW | GPIO_PULL_UP)>
		; */
	};
};
